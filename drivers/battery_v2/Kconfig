## drivers/battery_v2/Kconfig
```kconfig
config BATTERY_SAMSUNG
	tristate "samsung battery driver"
	help
	 Say Y to include support for samsung battery driver
	 This battery driver integrated all battery-related functions
	 To see battery-related functions,
	 refer to sec_charging_common.h

config BATTERY_SAMSUNG_V2
	tristate "samsung battery driver version 2"
	default n
	depends on BATTERY_SAMSUNG
	help
	 Say Y to include support for samsung battery driver
	 This battery driver integrated all battery-related functions
	 To see battery-related functions,
	 refer to sec_charging_common.h

config BATTERY_SWELLING
	bool "prevent battery swelling"
	help
	  Say Y to include support for prevent battery swelling

config BATTERY_SWELLING_SELF_DISCHARGING
	bool "prevent battery swelling with self discharging"
	help
	  Say Y to include support for prevent battery swelling with self discharging

config CALC_TIME_TO_FULL
	tristate "calculate time to full"
	default n
	depends on BATTERY_SAMSUNG
	help
	  Say Y to use calc time to full function.

config SW_SELF_DISCHARGING
	bool "enable sw_self_discharging"
	default n
	help
	  Say Y to enable CONFIG_SW_SELF_DISCHARGING

config BATTERY_AGE_FORECAST
	tristate "battery age forecast"
	default n
	depends on BATTERY_SWELLING
	help
	Say Y to use calc time to full function.

config BATTERY_AGE_FORECAST_DETACHABLE
	tristate "battery age forecast for detachable"
	default n
	select BATTERY_AGE_FORECAST
	help
	 Say Y to use battery age forecast for detachable battery models.
	 In detachable battery models the battery cycles
	 are calculated based on the RIL time to give an estimate
	 on weeks that the battery has been used to determine aging.

config FUELGAUGE_ASOC_FROM_CYCLES
	bool "FUELGAUGE ASOC output based on mapping with battery cycles"
	default n
	depends on BATTERY_AGE_FORECAST
	help
	 Say Y to enable support for the mapping of ASOC with charging cycles.
	 Support for this feature implies that a mapping table has been shared
	 from HW team and big data side. This feature is providing
	 support for platform required battery health monitoring concepts.

config MULTI_CHARGING
	bool "support for multi charger ICs"
	help
	Say Y to include support for multi charger ICs

config STEP_CHARGING
	bool "support for step charging"
	help
	 Say Y to include support for step charging

config UPDATE_BATTERY_DATA
	bool "support for updating battery data"
	default n
	depends on BATTERY_SAMSUNG && OF
	help
	 Say Y to include support for step charging

config AFC_CURR_CONTROL_BY_TEMP
	tristate "fast charging current control by temp"
	default n
	depends on BATTERY_SAMSUNG
	help
	 Say Y to set afc current control by temp

config BATTERY_CISD
	bool "support for cisd"
	help
	 Say Y to include support for cisd
	 cisd means cell internal short detection

# Fuel Gauge

config FUELGAUGE_S2MU004
	tristate "S2MU004 fuel gauge driver"
	default n
	depends on (MFD_S2MU004) && I2C
	help
	 Say Y to include support
	 for S.LSI S2MU004 fuel gauge driver.
	 Ths fuel-gauge supports current tracking and
	 voltage tracking to model the battery SOC.

# Charger
	 
config PDIC_PD30
	bool "support for PDIC_30"
	default y
	help
	 Say Y to include support for PDIC 30

config CHARGER_S2MU004
	tristate "S2MU004 charger support"
	depends on (MFD_S2MU004) && I2C
	help
	 Say Y here to enable support for the S2MU004 charger.
	 S2MU004 charger is an AFC compatible charging IC.
	 S2MU004 charger is dependent on MFD_S2MU004
	 so it needs to be defined.

config AFC_CHARGER_MODE
	bool "afc charging support in sec battery driver"
	default n
	depends on BATTERY_SAMSUNG
	help
	  Say Y to include support for sec afc charging support

config SAMSUNG_LPM_MODE
	bool "Off charging mode support in sec battery driver"
	default n
	help
	  Say Y to include support for sec off charging support
	  This value defined at bootloader.
	  Before enable this feature,
	  implemet power off charging in the bootloader.

config EN_OOPS
	bool "enable oops filter"
	default n
	help
	  Say Y to enable oops filter

config STORE_MODE
       bool "enable store mode"
       default n
       help
	 Say Y to enable CONFIG_STORE_MODE

config QH_ALGORITHM
       bool "enable QH algorithm"
       default n
       help
	 Say Y to enable CONFIG_QH_ALGORITHM

config BATTERY_NOTIFIER
	bool "battery notifier"
	default n
	help
	  Say Y to enable battery notifier

config ABNORMAL_BAT_THM_WA
	bool "enable SW Workaround for abnormal jump in battery thermistor ADC"
	default n
	help
	  Say Y to enable SW Workaround for abnormal jump in battery thermistor ADC

config S2MU004_MODE_CHANGE_BY_TOPOFF
	bool "enable s2mu004 mode change by topoff"
	default n
	help
	  Say Y to enable s2mu004 mode change by topoff
	  
```

## drivers/ccic/Kconfig
```kconfig
#
# USB PD driver
#

comment "USB PD configs"

config USE_CCIC
	bool "Using USBPD device driver"
	depends on I2C
	default n
	help
	  If you say yes here you will get support for
	  the USB PD(Power Delivery) device driver.

config CCIC_S2MU004
	bool "Using S2MU004 USB PD"
	depends on USE_CCIC
	default n
	help
	  If you say yes here you will get support for
	  for the S2MU004 USBPD chip.

config CCIC_MODE_BY_MUIC
	bool "Using CCIC operate mode by MUIC RID"
	depends on USE_CCIC
	default n
	help
	  If you say yes here you will get support for
	  MUIC to control ccic DRP Mode

config CCIC_MODE_WITHOUT_MUIC
	bool "Using CCIC operate mode without MUIC RID"
	depends on USE_CCIC
	default n
	help
	  If you say yes here ccic always operate drp without MUIC

config CCIC_VDM
	bool "Using S2MU004 USB PD VDM Message"
	depends on USE_CCIC
	default n
	help
	  If you say yes here you will get support for
	  for the S2MU004 USBPD chip.
	  
config CCIC_NOTIFIER
	bool "CCIC notifier support"
	depends on I2C
	default n
	help
	  If you say yes here you will get support for
	  the CCIC attached device status change notification.

config CCIC_ALTERNATE_MODE 
	bool "support CCIC alternate mode"
	depends on I2C
	default n
	help
	  If you say yes here you will get support for
	  alternate mode

config CCIC_EXTERNAL_CAPACITOR
	bool "support WATER DETECT tuning for ext cc cap"
	depends on USE_CCIC
	default n
	help
	  If you say yes here you will get support for
	  water detect tuning for external cc capacitor.

config CCIC_TYPEC_PRSWAP
	bool "support Power Role Swap"
	depends on USE_CCIC
	depends on CCIC_S2MU004
	depends on ANDROID_MAJOR_VERSION != "n"
	depends on ANDROID_MAJOR_VERSION != "o"
	depends on ANDROID_MAJOR_VERSION != "p"
	default y
```

## drivers/motor/Kconfig
```kconfig
	  
config MOTOR_ZH915
	tristate "motor"
	default n
	help
	  Say Y to enable MOTOR ZH915.

config MOTOR_S2MU004
	tristate "s2mu004 haptic driver"
	default n
	depends on I2C
	help
	 Say Y to include support for S.LSI S2MU004 Haptic driver.
```

## drivers/video/fbdev/exynos/dpu_7885/panels/Kconfig
```kconfig
config EXYNOS_DECON_LCD
	depends on EXYNOS_DECON_7885
	bool "Select LCD panel driver"

config EXYNOS_DECON_LCD_S6E3FA0
	depends on EXYNOS_DECON_LCD && EXYNOS_MIPI_DSIM
	tristate "S6E3FA0 AMOLED FHD LCD driver"

config EXYNOS_DECON_LCD_S6E3FA3
	depends on EXYNOS_DECON_LCD && EXYNOS_MIPI_DSIM
	tristate "S6E3FA3 AMOLED FHD LCD driver"

config EXYNOS_DECON_LCD_S6E3FA7
	depends on EXYNOS_DECON_LCD && EXYNOS_MIPI_DSIM
	tristate "S6E3FA7 AMOLED FHD+ LCD driver"

config DISPLAY_USE_INFO
	tristate "Support display use info logging"
	default n

config EXYNOS_DECON_MDNIE
	tristate "Support MDNIE"
	default n

config EXYNOS_DECON_MDNIE_LITE
	depends on EXYNOS_DECON_MDNIE
	tristate "Support backward compatibility for MDNIE"
	default y

config EXYNOS_DECON_MDNIE_CONTROL
	bool "Samsung Exynos7885 Display colour controller"
	default n

config SUPPORT_POC_FLASH
	depends on EXYNOS_DECON_LCD
	tristate "Support display poc flash"
	default n

config EXYNOS_DECON_LCD_S6E3FA7_JACKPOT2
	tristate "S6E3FA7_JACKPOT2 LCD driver"

config EXYNOS_DECON_LCD_S6E3FA7_JACKPOT
	tristate "S6E3FA7_JACKPOT LCD driver"

config EXYNOS_DECON_LCD_S6E8AA5_A6ELTE
	bool "S6E8AA5_A6ELTE LCD driver"

config EXYNOS_DECON_LCD_S6E8AA5_FEEL2
	bool "S6E8AA5_FEEL2 LCD driver"
```
